## boards/shields/palmctrl/Kconfig.shield
```kconfig
config SHIELD_PALMCTRL_LEFT
	def_bool $(shields_list_contains,palmctrl_left)

config SHIELD_PALMCTRL_RIGHT
	def_bool $(shields_list_contains,palmctrl_right)
```
